## config/boards/shields/totem/Kconfig.defconfig
```kconfig
# Copyright (c) 2022 The ZMK Contributors
# SPDX-License-Identifier: MIT

if SHIELD_TOTEM_DONGLE

config ZMK_KEYBOARD_NAME
    default "TOTEM"
    
config ZMK_SPLIT
    default y

config ZMK_SPLIT_ROLE_CENTRAL
    default y

config ZMK_BLE
    default n

config ZMK_USB
    default y

config ZMK_USB_BOOT
    default y 

config ZMK_SPLIT_BATTERY_HID_REPORT
    bool "Expose left/right peripheral battery levels via a custom USB HID report"
    default y
    depends on ZMK_USB && ZMK_SPLIT_BLE_CENTRAL_BATTERY_LEVEL_FETCHING

endif 

if SHIELD_TOTEM_LEFT || SHIELD_TOTEM_RIGHT 

config ZMK_SPLIT
    default y

config ZMK_BLE
    default y

endif
```
